#include <avr/io.h>
#include <avr/interrupt.h>
#include <avr/sleep.h>

volatile uint8_t wake_flag = 0;

ISR(PCINT0_vect) {
    wake_flag = 1;
}

int main(void) {
    DDRB |= (1 << PB0);    // Пин светодиода на выход (PB0)
    DDRB &= ~(1 << PB1);   // Пин кнопки на вход (PB1)
    PORTB |= (1 << PB1);   // Включаем внутренний подтягивающий резистор на PB1

    // Включаем прерывание по изменению состояния пинов
    GIMSK |= (1 << PCIE);   
    PCMSK |= (1 << PCINT1); // Устанавливаем маску для PB1 (PCINT1)

    set_sleep_mode(SLEEP_MODE_PWR_DOWN);
    sei();                  // Разрешаем глобальные прерывания

    while (1) {
        if (wake_flag) {
            // Фильтр помех: ждем несколько микросекунд и перепроверяем пин.
            // Если это был всплеск помех, пин уже будет высоким (1).
            for (volatile uint16_t i = 0; i < 200; i++) {
                // Короткое неблокирующее окно стабилизации
            }

            // Если пин все еще LOW, это настоящее нажатие кнопки
            if (!(PINB & (1 << PB1))) {
                PORTB ^= (1 << PB0); // Переключаем светодиод

                // Ждем физического отпускания кнопки (пин становится высоким)
                while (!(PINB & (1 << PB1))) {
                    // Ожидание отпускания
                }
            }

            wake_flag = 0;
        }

        // Уходим в режим глубокого сна
        sleep_enable();
        sleep_cpu();        // Процессор спит здесь, ток падает до ~0.1 мкА
        sleep_disable();
    }
}
